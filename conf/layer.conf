## conf/layer.conf
```bitbake
# We have a conf and classes directory, add to BBPATH
BBPATH .= ":${LAYERDIR}"

# We have recipes-* directories, add to BBFILES
BBFILES += "${LAYERDIR}/recipes-*/*/*.bb \
            ${LAYERDIR}/recipes-*/*/*.bbappend"

BBFILE_COLLECTIONS += "meta-aegpiokmod"
BBFILE_PATTERN_meta-aegpiokmod = "^${LAYERDIR}/"
BBFILE_PRIORITY_meta-aegpiokmod = "6"

LAYERDEPENDS_meta-aegpiokmod = "core"
LAYERSERIES_COMPAT_meta-aegpiokmod = "dunfell"
```
